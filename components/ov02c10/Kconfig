## components/ov02c10/Kconfig.ov02c10
```kconfig
menuconfig CAMERA_OV02C10
    bool "OV02C10"
    default y
    depends on IDF_TARGET_ESP32P4
    help
        Enable the OV02C10 MIPI-CSI camera sensor.

if CAMERA_OV02C10

    menuconfig CAMERA_OV02C10_AUTO_DETECT
        bool "Auto detect OV02C10"
        default y
        help
            Enable automatic OV02C10 detection during esp_video_init().

    if CAMERA_OV02C10_AUTO_DETECT
        config CAMERA_OV02C10_AUTO_DETECT_MIPI_INTERFACE_SENSOR
            bool "Detect OV02C10 on MIPI CSI"
            default y
            help
                Register the OV02C10 detector for the MIPI-CSI interface.
    endif

    choice CAMERA_OV02C10_MIPI_DEFAULT_FMT
        prompt "Default OV02C10 MIPI format"
        default CAMERA_OV02C10_MIPI_RAW10_1920X1080_2LAN_30FPS

        config CAMERA_OV02C10_MIPI_RAW10_1288X728_30FPS
            bool "RAW10 1288x728 30fps, MIPI 1 lane"

        config CAMERA_OV02C10_MIPI_RAW10_1920X1080_30FPS
            bool "RAW10 1920x1080 30fps, MIPI 1 lane"

        config CAMERA_OV02C10_MIPI_RAW10_1920X1080_2LAN_30FPS
            bool "RAW10 1920x1080 30fps, MIPI 2 lanes"
    endchoice

    config CAMERA_OV02C10_MIPI_IF_FORMAT_INDEX_DAFAULT
        int
        default 0 if CAMERA_OV02C10_MIPI_RAW10_1288X728_30FPS
        default 1 if CAMERA_OV02C10_MIPI_RAW10_1920X1080_30FPS
        default 2 if CAMERA_OV02C10_MIPI_RAW10_1920X1080_2LAN_30FPS

    config CAMERA_OV02C10_CSI_LINESYNC_ENABLE
        bool "CSI line sync enable"
        default y

    config CAMERA_OV02C10_ISP_AF_ENABLE
        bool "ISP autofocus / VCM support"
        default y

    config CAMERA_OV02C10_MAX_SUPPORT
        int "Maximum OV02C10 sensor instances"
        default 1
        range 1 4

    config CAMERA_OV02C10_ABSOLUTE_GAIN_LIMIT
        int "Maximum absolute gain limit"
        default 66016
        range 4000 126016

    choice CAMERA_OV02C10_ABS_GAIN_MAP_PRIORITY
        prompt "Gain map select"
        default CAMERA_OV02C10_ANA_GAIN_PRIORITY

        config CAMERA_OV02C10_ANA_GAIN_PRIORITY
            bool "Analog gain priority"

        config CAMERA_OV02C10_DIG_GAIN_PRIORITY
            bool "Digital gain priority"
    endchoice

endif
```

## main/boards/guition-jc1060p470/patches/kconfig.guition.patch
```kconfig
--- a/main/Kconfig.projbuild
+++ b/main/Kconfig.projbuild
@@ -128,7 +128,7 @@
     default BOARD_TYPE_ESP_SENSAIRSHUTTLE if IDF_TARGET_ESP32C5
     default BOARD_TYPE_WAVESHARE_ESP32_C6_TOUCH_AMOLED_2_06 if IDF_TARGET_ESP32C6
     default BOARD_TYPE_BREAD_COMPACT_WIFI if IDF_TARGET_ESP32S3
-    default BOARD_TYPE_ESP32_P4_FUNCTION_EV_BOARD if IDF_TARGET_ESP32P4
+    default BOARD_TYPE_GUITION_JC1060P470 if IDF_TARGET_ESP32P4
     default BOARD_TYPE_ESP32_S31_FUNCTION_COREBOARD_1 if IDF_TARGET_ESP32S31
     help
         Select the physical board hardware implementation.
@@ -197,6 +197,9 @@
     config BOARD_TYPE_ESP32_P4_FUNCTION_EV_BOARD
         bool "Espressif ESP32-P4/P4X-Function-EV-Board"
         depends on IDF_TARGET_ESP32P4
+    config BOARD_TYPE_GUITION_JC1060P470
+        bool "Guition JC1060P470C 7\" (ESP32-P4 + C6, JD9165, GT911)"
+        depends on IDF_TARGET_ESP32P4
     config BOARD_TYPE_ESP32_S3_BOX
         bool "Espressif ESP32-S3-BOX"
         depends on IDF_TARGET_ESP32S3
```
